## boards/embeddedfire/challenger_stm32f429/board.yml
```yaml
board:
  name: challenger_stm32f429
  vendor: embeddedfire 
  socs:
    - name: stm32f429xx
```

## boards/embeddedfire/challenger_stm32f429/challenger_stm32f429_defconfig
```kconfig
# SPDX-License-Identifier: Apache-2.0

# Enable MPU
# CONFIG_ARM_MPU=y

# Enable HW stack protection
# CONFIG_HW_STACK_PROTECTION=y

# CONFIG_SERIAL=y

# console
# CONFIG_CONSOLE=y
# CONFIG_USE_SEGGER_RTT=y
# CONFIG_RTT_CONSOLE=y
# CONFIG_UART_CONSOLE=y

# shell
# CONFIG_SHELL=y

# enable GPIO
# CONFIG_GPIO=y 

# # Enable MPU
CONFIG_ARM_MPU=y

# # Enable HW stack protection
CONFIG_HW_STACK_PROTECTION=y

CONFIG_SERIAL=y

# # console
CONFIG_CONSOLE=y
CONFIG_UART_CONSOLE=y

# # enable GPIO
CONFIG_GPIO=y
```

## west.yml
```yaml
manifest:
  self:
    path: akadimia-sdk
    
  remotes:
    - name: zephyr
      url-base: https://github.com/zephyrproject-rtos

  projects:
    - name: zephyr
      remote: zephyr
      import: true
```
